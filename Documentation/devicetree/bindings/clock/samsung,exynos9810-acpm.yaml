## Documentation/devicetree/bindings/clock/samsung,exynos9810-acpm.yaml
```yaml
# SPDX-License-Identifier: (GPL-2.0-only OR BSD-2-Clause)
%YAML 1.2
---
$id: http://devicetree.org/schemas/clock/samsung,exynos9810-acpm.yaml#
$schema: http://devicetree.org/meta-schemas/core.yaml#

title: Samsung Exynos9810 ACPM DVFS clocks

maintainers:
  - Mathias Gluszczynski <admin@krazey.de>

description: |
  ACPM firmware coordinates clock and voltage changes for the Exynos9810
  DVFS domains. Clock rates sent over the firmware interface are expressed
  in kHz.

properties:
  compatible:
    const: samsung,exynos9810-acpm-dvfs

  "#clock-cells":
    const: 1

  acpm-ipc-channel:
    $ref: /schemas/types.yaml#/definitions/uint32
    description: ACPM firmware channel used for DVFS requests.

required:
  - compatible
  - "#clock-cells"
  - acpm-ipc-channel

additionalProperties: false

examples:
  - |
    clock-controller {
        compatible = "samsung,exynos9810-acpm-dvfs";
        #clock-cells = <1>;
        acpm-ipc-channel = <5>;
    };
...
```

## Documentation/devicetree/bindings/clock/samsung,exynos9810-clock.yaml
```yaml
# SPDX-License-Identifier: (GPL-2.0-only OR BSD-2-Clause)
%YAML 1.2
---
$id: http://devicetree.org/schemas/clock/samsung,exynos9810-clock.yaml#
$schema: http://devicetree.org/meta-schemas/core.yaml#

title: Samsung Exynos9810 SoC clock controller

maintainers:
  - Mathias Gluszczynski <admin@krazey.de>

description: |
  The Exynos9810 clock controller is split into multiple CMU blocks. Each CMU
  generates clocks for a separate hardware domain and is represented by an
  individual device tree node.

  The root clock is an external 26 MHz oscillator. Domain input clocks are
  generated by CMU_TOP and supplied to the leaf CMU nodes.

  Clock identifiers consumed by device nodes are defined in
  include/dt-bindings/clock/samsung,exynos9810.h.

properties:
  compatible:
    enum:
      - samsung,exynos9810-cmu-cmgp
      - samsung,exynos9810-cmu-dpu
      - samsung,exynos9810-cmu-fsys0
      - samsung,exynos9810-cmu-fsys1
      - samsung,exynos9810-cmu-peric0
      - samsung,exynos9810-cmu-top

  clocks:
    minItems: 2
    maxItems: 4

  clock-names:
    minItems: 2
    maxItems: 4

  "#clock-cells":
    const: 1

  reg:
    maxItems: 1

allOf:
  - if:
      properties:
        compatible:
          contains:
            const: samsung,exynos9810-cmu-top

    then:
      properties:
        clocks:
          minItems: 2
          maxItems: 2
          items:
            - description: External reference clock
            - description: Bootstrap source for the CMGP bus clock

        clock-names:
          minItems: 2
          maxItems: 2
          items:
            - const: oscclk
            - const: cmgp_bus_bootclk

  - if:
      properties:
        compatible:
          contains:
            const: samsung,exynos9810-cmu-dpu

    then:
      properties:
        clocks:
          minItems: 2
          maxItems: 2
          items:
            - description: External reference clock
            - description: CMU_DPU bus clock from CMU_TOP

        clock-names:
          minItems: 2
          maxItems: 2
          items:
            - const: oscclk
            - const: dout_clkcmu_dpu_bus

  - if:
      properties:
        compatible:
          contains:
            const: samsung,exynos9810-cmu-fsys0

    then:
      properties:
        clocks:
          minItems: 4
          maxItems: 4
          items:
            - description: External reference clock
            - description: CMU_FSYS0 bus clock from CMU_TOP
            - description: Embedded UFS clock from CMU_TOP
            - description: USB DRD clock from CMU_TOP

        clock-names:
          minItems: 4
          maxItems: 4
          items:
            - const: oscclk
            - const: dout_clkcmu_fsys0_bus
            - const: dout_clkcmu_fsys0_ufs_embd
            - const: dout_clkcmu_fsys0_usb30drd

  - if:
      properties:
        compatible:
          contains:
            const: samsung,exynos9810-cmu-fsys1

    then:
      properties:
        clocks:
          minItems: 3
          maxItems: 3
          items:
            - description: External reference clock
            - description: CMU_FSYS1 bus clock from CMU_TOP
            - description: PCIe reference clock from CMU_TOP

        clock-names:
          minItems: 3
          maxItems: 3
          items:
            - const: oscclk
            - const: dout_clkcmu_fsys1_bus
            - const: dout_clkcmu_fsys1_pcie

  - if:
      properties:
        compatible:
          contains:
            const: samsung,exynos9810-cmu-peric0

    then:
      properties:
        clocks:
          minItems: 3
          maxItems: 3
          items:
            - description: External reference clock
            - description: CMU_PERIC0 bus clock from CMU_TOP
            - description: CMU_PERIC0 IP clock from CMU_TOP

        clock-names:
          minItems: 3
          maxItems: 3
          items:
            - const: oscclk
            - const: dout_clkcmu_peric0_bus
            - const: dout_clkcmu_peric0_ip

  - if:
      properties:
        compatible:
          contains:
            const: samsung,exynos9810-cmu-cmgp

    then:
      properties:
        clocks:
          minItems: 2
          maxItems: 2
          items:
            - description: External reference clock
            - description: CMU_CMGP bus clock from CMU_TOP

        clock-names:
          minItems: 2
          maxItems: 2
          items:
            - const: oscclk
            - const: dout_clkcmu_cmgp_bus

required:
  - compatible
  - "#clock-cells"
  - clocks
  - clock-names
  - reg

additionalProperties: false

examples:
  - |
    clock-controller@10400000 {
        compatible = "samsung,exynos9810-cmu-peric0";
        reg = <0x10400000 0x8000>;
        #clock-cells = <1>;

        clocks = <&oscclk>, <&peric0_bus>, <&peric0_ip>;
        clock-names = "oscclk", "dout_clkcmu_peric0_bus",
                      "dout_clkcmu_peric0_ip";
    };

...
```

## Documentation/devicetree/bindings/display/samsung/samsung,exynos9810-bootfb.yaml
```yaml
# SPDX-License-Identifier: (GPL-2.0-only OR BSD-2-Clause)
%YAML 1.2
---
$id: http://devicetree.org/schemas/display/samsung/samsung,exynos9810-bootfb.yaml#
$schema: http://devicetree.org/meta-schemas/core.yaml#

title: Samsung Exynos9810 preserved boot framebuffer

maintainers:
  - Mathias Gluszczynski <admin@krazey.de>

description: |
  Samsung's Exynos9810 bootloader leaves the internal display pipeline
  scanning out a reserved framebuffer. This binding describes that scanout
  while native DECON, DPP and DSIM support is unavailable. The register
  resource identifies the primary DECON instance and preserves the legacy
  platform-device name used by Android userspace.

properties:
  compatible:
    const: samsung,exynos9810-bootfb

  reg:
    maxItems: 1

  memory-region:
    maxItems: 1
    description: Reserved framebuffer scanned out by the bootloader.

  width:
    $ref: /schemas/types.yaml#/definitions/uint32

  height:
    $ref: /schemas/types.yaml#/definitions/uint32

  stride:
    $ref: /schemas/types.yaml#/definitions/uint32

  width-mm:
    $ref: /schemas/types.yaml#/definitions/uint32

  height-mm:
    $ref: /schemas/types.yaml#/definitions/uint32

required:
  - compatible
  - reg
  - memory-region
  - width
  - height
  - stride
  - width-mm
  - height-mm

additionalProperties: false

examples:
  - |
    / {
        #address-cells = <2>;
        #size-cells = <1>;

        reserved-memory {
            #address-cells = <2>;
            #size-cells = <1>;
            ranges;

            framebuffer: framebuffer@cc000000 {
                reg = <0x0 0xcc000000 0x01042800>;
                no-map;
            };
        };

        decon_f@16030000 {
            compatible = "samsung,exynos9810-bootfb";
            reg = <0x0 0x16030000 0x1000>;
            memory-region = <&framebuffer>;
            width = <1440>;
            height = <2960>;
            stride = <5760>;
            width-mm = <64>;
            height-mm = <132>;
        };
    };
...
```

## Documentation/devicetree/bindings/net/wireless/samsung,brcm-wlan.yaml
```yaml
# SPDX-License-Identifier: (GPL-2.0-only OR BSD-2-Clause)
%YAML 1.2
---
$id: http://devicetree.org/schemas/net/wireless/samsung,brcm-wlan.yaml#
$schema: http://devicetree.org/meta-schemas/core.yaml#

title: Samsung Exynos Broadcom DHD platform data

maintainers:
  - Mathias Gluszczynski <admin@krazey.de>

description:
  Samsung Exynos devices using the Broadcom DHD driver expose an
  out-of-band interrupt from the WLAN endpoint.  WLAN power and PCIe
  enumeration are controlled by the PCIe host and its regulator.

properties:
  compatible:
    const: samsung,brcm-wlan

  host-wake-gpios:
    description:
      GPIO asserted by the WLAN endpoint to wake the host.
    maxItems: 1

  pinctrl-names:
    items:
      - const: default

  pinctrl-0: true

required:
  - compatible
  - host-wake-gpios

additionalProperties: false

examples:
  - |
    #include <dt-bindings/gpio/gpio.h>

    wlan {
        compatible = "samsung,brcm-wlan";
        host-wake-gpios = <&gpa0 7 GPIO_ACTIVE_HIGH>;
    };

...
```

## Documentation/devicetree/bindings/pci/samsung,exynos-pcie.yaml
```yaml
# SPDX-License-Identifier: (GPL-2.0-only OR BSD-2-Clause)
%YAML 1.2
---
$id: http://devicetree.org/schemas/pci/samsung,exynos-pcie.yaml#
$schema: http://devicetree.org/meta-schemas/core.yaml#

title: Samsung SoC series PCIe Host Controller

maintainers:
  - Marek Szyprowski <m.szyprowski@samsung.com>
  - Jaehoon Chung <jh80.chung@samsung.com>

description: |+
  Samsung Exynos PCIe host controllers are based on the Synopsys DesignWare
  PCIe IP and inherit all common properties defined in snps,dw-pcie.yaml.

allOf:
  - $ref: /schemas/pci/snps,dw-pcie.yaml#

  - if:
      properties:
        compatible:
          contains:
            const: samsung,exynos5433-pcie

    then:
      properties:
        reg:
          items:
            - description: Data Bus Interface (DBI) registers
            - description: External Local Bus interface (ELBI) registers
            - description: PCIe configuration space region

        reg-names:
          items:
            - const: dbi
            - const: elbi
            - const: config

        clocks:
          items:
            - description: PCIe bridge clock
            - description: PCIe bus clock

        clock-names:
          items:
            - const: pcie
            - const: pcie_bus

      required:
        - phys
        - vdd10-supply
        - vdd18-supply

  - if:
      properties:
        compatible:
          contains:
            const: samsung,exynos9810-pcie

    then:
      properties:
        reg:
          items:
            - description: Data Bus Interface (DBI) registers
            - description: External Local Bus interface (ELBI) registers
            - description: PCIe configuration space region
            - description: Integrated PHY PMA registers
            - description: Integrated PHY PCS registers
            - description: Internal automation registers

        reg-names:
          items:
            - const: dbi
            - const: elbi
            - const: config
            - const: phy
            - const: pcs
            - const: ia

        clocks:
          items:
            - description: PCIe PHY reference clock
            - description: PCIe DBI bus clock
            - description: PCIe PHY APB clock
            - description: PCIe master bus clock
            - description: PCIe sub-controller APB clock
            - description: PCIe PCS APB clock
            - description: PCIe slave bus clock

        clock-names:
          items:
            - const: phy_ref
            - const: dbi
            - const: phy_apb
            - const: mstr
            - const: subctrl
            - const: pcs
            - const: slv

        phys: false
        vdd10-supply: false
        vdd18-supply: false
        max-link-speed:
          const: 2

      required:
        - max-link-speed
        - reset-gpios
        - samsung,fsys-sysreg
        - samsung,pmu-syscon
        - vpcie3v3-supply

properties:
  compatible:
    enum:
      - samsung,exynos5433-pcie
      - samsung,exynos9810-pcie

  reg:
    minItems: 3
    maxItems: 6

  reg-names:
    minItems: 3
    maxItems: 6

  interrupts:
    maxItems: 1

  clocks:
    minItems: 2
    maxItems: 7

  clock-names:
    minItems: 2
    maxItems: 7

  phys:
    maxItems: 1

  samsung,fsys-sysreg:
    $ref: /schemas/types.yaml#/definitions/phandle
    description:
      Phandle to the FSYS1 system register controller used by the
      integrated PCIe PHY.

  samsung,pmu-syscon:
    $ref: /schemas/types.yaml#/definitions/phandle
    description:
      Phandle to the PMU system controller used to power the PCIe PHY.

  vdd10-supply:
    description:
      Phandle to a regulator that provides 1.0V power to the PCIe block.

  vdd18-supply:
    description:
      Phandle to a regulator that provides 1.8V power to the PCIe block.

  vpcie3v3-supply:
    description:
      Phandle to the regulator that controls power to the PCIe endpoint.

  num-lanes:
    const: 1

  num-viewport:
    const: 3

required:
  - reg
  - reg-names
  - interrupts
  - "#address-cells"
  - "#size-cells"
  - "#interrupt-cells"
  - interrupt-map
  - interrupt-map-mask
  - ranges
  - bus-range
  - device_type
  - num-lanes
  - num-viewport
  - clocks
  - clock-names

unevaluatedProperties: false

examples:
  - |
    #include <dt-bindings/interrupt-controller/irq.h>
    #include <dt-bindings/interrupt-controller/arm-gic.h>
    #include <dt-bindings/clock/exynos5433.h>

    pcie: pcie@15700000 {
        compatible = "samsung,exynos5433-pcie";
        reg = <0x15700000 0x1000>, <0x156b0000 0x1000>, <0x0c000000 0x1000>;
        reg-names = "dbi", "elbi", "config";
        #address-cells = <3>;
        #size-cells = <2>;
        #interrupt-cells = <1>;
        device_type = "pci";
        interrupts = <GIC_SPI 245 IRQ_TYPE_LEVEL_HIGH>;
        clocks = <&cmu_fsys CLK_PCIE>, <&cmu_fsys CLK_PCLK_PCIE_PHY>;
        clock-names = "pcie", "pcie_bus";
        phys = <&pcie_phy>;
        pinctrl-0 = <&pcie_bus &pcie_wlanen>;
        pinctrl-names = "default";
        num-lanes = <1>;
        num-viewport = <3>;
        bus-range = <0x00 0xff>;
        ranges = <0x81000000 0 0	  0x0c001000 0 0x00010000>,
                 <0x82000000 0 0x0c011000 0x0c011000 0 0x03feefff>;
        vdd10-supply = <&ldo6_reg>;
        vdd18-supply = <&ldo7_reg>;
        interrupt-map-mask = <0 0 0 0>;
        interrupt-map = <0 0 0 0 &gic GIC_SPI 245 IRQ_TYPE_LEVEL_HIGH>;
    };
...
```
