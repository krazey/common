## Documentation/devicetree/bindings/power/supply/maxim,max77705.yaml
```yaml
# SPDX-License-Identifier: GPL-2.0-only OR BSD-2-Clause
%YAML 1.2
---
$id: http://devicetree.org/schemas/power/supply/maxim,max77705.yaml#
$schema: http://devicetree.org/meta-schemas/core.yaml#

title: Maxim MAX77705 charger

maintainers:
  - Dzmitry Sankouski <dsankouski@gmail.com>

description: |
  Battery charger block in the Maxim MAX77705 power-management IC.

allOf:
  - $ref: power-supply.yaml#

properties:
  compatible:
    const: maxim,max77705-charger

  interrupts:
    maxItems: 1

  reg:
    maxItems: 1

  extcon:
    maxItems: 1
    description:
      Phandle to the MAX77705 MUIC connector used to select the board
      charging-current policy.

  maxim,enable-watchdog:
    type: boolean
    description:
      Enable and periodically service the charger watchdog while charging.

  maxim,default-input-current-microamp:
    minimum: 100000
    maximum: 3200000
    description:
      Input current limit used for cable types absent from the current table.

  maxim,default-charge-current-microamp:
    minimum: 100000
    maximum: 3150000
    description:
      Charge current used for cable types absent from the current table.

  maxim,input-current-max-microamp:
    minimum: 100000
    maximum: 3200000
    description:
      Board limit applied to every programmed input current.

  maxim,b2s-overcurrent-microamp:
    description:
      Battery-to-system overcurrent threshold. Zero disables protection.
    enum: [0, 4600000, 4800000, 5000000, 5200000, 5400000, 5600000,
           5800000, 6000000, 6200000]

  maxim,charging-current-table:
    $ref: /schemas/types.yaml#/definitions/uint32-matrix
    minItems: 1
    maxItems: 64
    description:
      Board charging policy indexed by the platform cable-type identifier.
      Each row contains the cable type, input current limit in microamps and
      charge current in microamps.
    items:
      items:
        - description: Platform cable-type identifier
          maximum: 255
        - description: Input current limit in microamps
          minimum: 100000
          maximum: 3200000
        - description: Charge current in microamps
          minimum: 100000
          maximum: 3150000

required:
  - compatible
  - reg
  - monitored-battery

unevaluatedProperties: false

examples:
  - |
    i2c {
        #address-cells = <1>;
        #size-cells = <0>;

        charger@69 {
            compatible = "maxim,max77705-charger";
            reg = <0x69>;
            monitored-battery = <&battery>;
            interrupt-parent = <&max77705>;
            interrupts = <0>;
            maxim,enable-watchdog;
            maxim,b2s-overcurrent-microamp = <5600000>;
            maxim,input-current-max-microamp = <3000000>;
            maxim,default-input-current-microamp = <1800000>;
            maxim,default-charge-current-microamp = <2100000>;
        };
    };
```

## Documentation/devicetree/bindings/soc/samsung/samsung,exynos9810-pmu-intr-gen.yaml
```yaml
# SPDX-License-Identifier: (GPL-2.0 OR BSD-2-Clause)
%YAML 1.2
---
$id: http://devicetree.org/schemas/soc/samsung/samsung,exynos9810-pmu-intr-gen.yaml#
$schema: http://devicetree.org/meta-schemas/core.yaml#

title: Samsung Exynos9810 PMU Interrupt Generator

description: |
  Interrupt handshake registers shared by the application processors and
  the ACPM firmware for CPU power-state transitions.

maintainers:
  - Mathias Gluszczynski <admin@krazey.de>

properties:
  compatible:
    items:
      - const: samsung,exynos9810-pmu-intr-gen
      - const: syscon

  reg:
    maxItems: 1

required:
  - compatible
  - reg

additionalProperties: false

examples:
  - |
    pmu_intr_gen: syscon@14070000 {
        compatible = "samsung,exynos9810-pmu-intr-gen", "syscon";
        reg = <0x14070000 0x1000>;
    };
...
```

## Documentation/devicetree/bindings/soc/samsung/samsung,exynos9810-shmem.yaml
```yaml
# SPDX-License-Identifier: (GPL-2.0-only OR BSD-2-Clause)
%YAML 1.2
---
$id: http://devicetree.org/schemas/soc/samsung/samsung,exynos9810-shmem.yaml#
$schema: http://devicetree.org/meta-schemas/core.yaml#

title: Samsung Exynos9810 firmware shared memory

maintainers:
  - Mathias Gluszczynski <admin@krazey.de>

description:
  The Exynos9810 modem reservation contains regions shared with the ABOX
  audio firmware. The layout provider exposes the voice-service firmware
  and parameter regions while retaining the stock physical boundaries.

properties:
  $nodename:
    const: shared-memory

  compatible:
    const: samsung,exynos9810-shmem

  memory-region:
    maxItems: 1
    description: Reserved modem memory containing the shared regions.

  samsung,cp-size:
    $ref: /schemas/types.yaml#/definitions/uint32
    const: 0x7900000
    description: Size of the modem firmware area before the VSS region.

  samsung,vss-size:
    $ref: /schemas/types.yaml#/definitions/uint32
    const: 0x700000
    description: Size of the ABOX voice-service firmware region.

  samsung,ipc-offset:
    $ref: /schemas/types.yaml#/definitions/uint32
    const: 0x8000000
    description: Offset of the modem IPC region in the reservation.

  samsung,ipc-size:
    $ref: /schemas/types.yaml#/definitions/uint32
    const: 0x500000
    description: Size of the modem IPC region.

  samsung,zmb-offset:
    $ref: /schemas/types.yaml#/definitions/uint32
    const: 0x8500000
    description: Offset of the modem zero-copy buffer region.

  samsung,zmb-size:
    $ref: /schemas/types.yaml#/definitions/uint32
    const: 0xb00000
    description: Size of the modem zero-copy buffer region.

  samsung,vparam-size:
    $ref: /schemas/types.yaml#/definitions/uint32
    const: 0x200000
    description: Size of the voice-service parameter region.

required:
  - compatible
  - memory-region
  - samsung,cp-size
  - samsung,vss-size
  - samsung,ipc-offset
  - samsung,ipc-size
  - samsung,zmb-offset
  - samsung,zmb-size
  - samsung,vparam-size

additionalProperties: false

examples:
  - |
    reserved-memory {
        #address-cells = <2>;
        #size-cells = <1>;
        ranges;

        modem_memory: memory@f0000000 {
            reg = <0x0 0xf0000000 0x9200000>;
            no-map;
        };
    };

    shared-memory {
        compatible = "samsung,exynos9810-shmem";
        memory-region = <&modem_memory>;
        samsung,cp-size = <0x7900000>;
        samsung,vss-size = <0x700000>;
        samsung,ipc-offset = <0x8000000>;
        samsung,ipc-size = <0x500000>;
        samsung,zmb-offset = <0x8500000>;
        samsung,zmb-size = <0xb00000>;
        samsung,vparam-size = <0x200000>;
    };
...
```

## Documentation/devicetree/bindings/sound/maxim,max98512.yaml
```yaml
# SPDX-License-Identifier: (GPL-2.0-only OR BSD-2-Clause)
%YAML 1.2
---
$id: http://devicetree.org/schemas/sound/maxim,max98512.yaml#
$schema: http://devicetree.org/meta-schemas/core.yaml#

title: Maxim Integrated MAX98512 Speaker Amplifier

maintainers:
  - Mathias Gluszczynski <admin@krazey.de>

description: |
  The MAX98512 is a mono digital-input class-D speaker amplifier.
  A second MAX98512 at another I2C address can be controlled by the
  same driver for stereo speaker configurations.

allOf:
  - $ref: dai-common.yaml#

properties:
  compatible:
    const: maxim,max98512

  reg:
    maxItems: 1

  '#sound-dai-cells':
    const: 0

  maxim,secondary-address:
    description:
      I2C address of an optional second amplifier. Its presence selects
      the stereo speaker configuration.
    $ref: /schemas/types.yaml#/definitions/uint32
    minimum: 8
    maximum: 119

  maxim,spk-gain:
    description: Default PCM speaker gain register value.
    $ref: /schemas/types.yaml#/definitions/uint32
    maximum: 7

  maxim,spk-gain-left:
    description: Initial left speaker gain register value.
    $ref: /schemas/types.yaml#/definitions/uint32
    maximum: 7

  maxim,spk-gain-right:
    description: Initial right speaker gain register value.
    $ref: /schemas/types.yaml#/definitions/uint32
    maximum: 7

  maxim,spk-gain-rcv:
    description: Receiver-mode speaker gain register value.
    $ref: /schemas/types.yaml#/definitions/uint32
    maximum: 7

  maxim,digital-gain:
    description: Default digital gain register value.
    $ref: /schemas/types.yaml#/definitions/uint32
    maximum: 127

  maxim,digital-gain-rcv:
    description: Receiver-mode digital gain register value.
    $ref: /schemas/types.yaml#/definitions/uint32
    maximum: 127

  maxim,current-limit-left:
    description: Left amplifier brownout current-limit register value.
    $ref: /schemas/types.yaml#/definitions/uint32
    maximum: 63

  maxim,current-limit-right:
    description: Right amplifier brownout current-limit register value.
    $ref: /schemas/types.yaml#/definitions/uint32
    maximum: 63

  maxim,sysclk-hz:
    description: PCM master clock frequency.
    enum:
      - 5644800
      - 6000000
      - 6144000
      - 6500000
      - 9600000
      - 11289600
      - 12000000
      - 12288000
      - 13000000
      - 19200000

  maxim,boost-step:
    description: Boost-voltage register values for the volume steps.
    $ref: /schemas/types.yaml#/definitions/uint32-array
    minItems: 16
    maxItems: 16
    items:
      maximum: 31

  maxim,adc-threshold:
    description: Volume step at which ADC-based boost control is enabled.
    $ref: /schemas/types.yaml#/definitions/uint32
    maximum: 15

  maxim,interleave-mode:
    description: Interleave voltage and current monitor samples.
    type: boolean

  maxim,vmon-left-slot:
    description: Left amplifier voltage-monitor TDM slot.
    $ref: /schemas/types.yaml#/definitions/uint32
    maximum: 15

  maxim,imon-left-slot:
    description: Left amplifier current-monitor TDM slot.
    $ref: /schemas/types.yaml#/definitions/uint32
    maximum: 15

  maxim,vmon-right-slot:
    description: Right amplifier voltage-monitor TDM slot.
    $ref: /schemas/types.yaml#/definitions/uint32
    maximum: 15

  maxim,imon-right-slot:
    description: Right amplifier current-monitor TDM slot.
    $ref: /schemas/types.yaml#/definitions/uint32
    maximum: 15

  maxim,no-dsm:
    description: Disable voltage and current monitor feedback.
    type: boolean

  maxim,platform-info:
    description:
      Samsung ABOX DSM platform type, port and module identifiers,
      filter selector, and algorithm version. Platform type 2 selects
      the ABOX transport used by Exynos9810.
    $ref: /schemas/types.yaml#/definitions/uint32-array
    minItems: 6
    maxItems: 6

required:
  - compatible
  - reg

unevaluatedProperties: false

examples:
  - |
    i2c {
      #address-cells = <1>;
      #size-cells = <0>;

      amplifier@39 {
        compatible = "maxim,max98512";
        reg = <0x39>;
        maxim,secondary-address = <0x3a>;
        maxim,spk-gain = <5>;
        maxim,spk-gain-rcv = <1>;
        maxim,digital-gain-rcv = <52>;
        maxim,sysclk-hz = <12288000>;
        maxim,platform-info = <2 0 0 0 0 52>;
        maxim,boost-step = <15 15 15 15 15 15 15 15
                            15 15 15 15 15 15 2 0>;
        maxim,adc-threshold = <7>;
        maxim,interleave-mode;
      };
    };
...
```

## drivers/gpu/arm/Kconfig
```kconfig
# SPDX-License-Identifier: GPL-2.0-only


menu "ARM GPU Configuration"

source "drivers/gpu/arm/bv_r38p1/Kconfig"

endmenu
```

## drivers/tee/trustonic/Kconfig
```kconfig
# SPDX-License-Identifier: GPL-2.0-only

config TRUSTONIC_TEE
	bool "Trustonic MobiCore TEE support"
	depends on ARM64 && ARCH_EXYNOS
	select DMA_SHARED_BUFFER
	help
	  Enable the Trustonic MobiCore interface used by the secure-world
	  firmware on Samsung Exynos9810 devices.

config TRUSTONIC_TEE_LPAE
	bool "Use 64-bit Trustonic physical addresses"
	depends on TRUSTONIC_TEE
	default y if ARM64
	help
	  Enable the long physical address format used by the Exynos9810
	  secure-world firmware.
```
